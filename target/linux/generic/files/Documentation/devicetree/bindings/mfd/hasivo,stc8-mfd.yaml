## target/linux/generic/files/Documentation/devicetree/bindings/mfd/hasivo,stc8-mfd.yaml
```yaml
# SPDX-License-Identifier: GPL-2.0
# STC8 MFD binding for Hasivo switches
# Defines properties for MFD regmap wrapper, LEDs, and PWM

title: "STC8 multi-function device"
description: |
  This binding describes the Hasivo STC8 multi-function device.
  This is an STC8 microcontroller with custom firmware used by Hasivo to
  provide various functions on their managed switch products.
  The main known functionality currently is to allow for discrete GPIO control
  which turns on/off LEDs and controls PWM for fan speed.
  It is known that for the discrete IO however, the host must send an execute
  flag (0x40) along with the register write to have the STC8 apply the change.
  This binding allows for specifying which registers require this execute flag
  to be set automatically by the MFD driver.

maintainers:
  - bevan.weiss@gmail.com

properties:
  compatible:
    description: >
      Must be "hasivo,stc8" for the MFD driver to bind.
    type: string
    required: true

  reg:
    description: >
      I2C address of the STC8 device.
    type: array of integers
    required: true

  reg-names:
    description: >
      Names of register blocks for the device.
    type: array of strings
    required: true

  hasivo,execute-bit-regs:
    description: >
      Array of registers for which the execute-bit (0x40) should be
      automatically ORed on writes.
    type: array of integers
    required: false

children:
```

## target/linux/generic/files/Documentation/devicetree/bindings/net/pse-pd/hasivo,hs104.yaml
```yaml
# SPDX-License-Identifier: (GPL-2.0-only OR BSD-2-Clause)
%YAML 1.2
---
$id: http://devicetree.org/schemas/net/pse-pd/hasivo,hs104.yaml#
$schema: http://devicetree.org/meta-schemas/core.yaml#

title: Hasivo HS104 Power Sourcing Equipment controller

maintainers:
  - Bevan Weiss <bevan.weiss@gmail.com>

allOf:
  - $ref: pse-controller.yaml#

properties:
  compatible:
    description: Device compatible string.
    enum:
      - hasivo,hs104pti
      - hasivo,hs104pbi

  reg:
    maxItems: 1

  hasivo,port-enable-delay-ms:
    $ref: /schemas/types.yaml#/definitions/uint32
    description: Delay in milliseconds after enabling a port before proceeding.
    minimum: 0
    maximum: 65535

unevaluatedProperties: false

required:
  - compatible
  - reg

examples:
  - |
    i2c {
      #address-cells = <1>;
      #size-cells = <0>;

      ethernet-pse@15 {
        compatible = "hasivo,hs104pti";
        reg = <0x15>;
        hasivo,port-enable-delay-ms = <300>;
      };
    };
```

## target/linux/realtek/files-5.15/Documentation/devicetree/bindings/clock/realtek,otto-clock.yaml
```yaml
# SPDX-License-Identifier: GPL-2.0
%YAML 1.2
---
$id: http://devicetree.org/schemas/clock/realtek,rtl8380-clock.yaml#
$schema: http://devicetree.org/meta-schemas/core.yaml#

title: Realtek clock control unit Device Tree Bindings

maintainers:
  - Olliver Schinagl <oliver@schinagl.nl>

description: |
  The driver provides basic clock support for the central core clock unit (CCU)
  and its PLLs inside the RTL838X, RTL8389X and RTL930X SOC. All provided clocks
  are derived from an oscillator that runs at a fixed speed of 25 MHz. Currently
  switch, CPU, memory and LXB (Lexra Bus) clock information can be accessed. The
  clocks can be referenced by 'include/dt-bindings/clock/rtl83xx-clk.h'.

  If changing of clock speeds is required then SRAM must be defined via DT.
  The relevant code is copied to SRAM and run from there. To provide SRAM
  see http://devicetree.org/schemas/sram/sram.yaml#. E.g.

  sram0: sram@9f000000 {
  ...
 	pll_reclock_sram@0 {
 		reg = <0x0 0x20>;
 		pool;
 	};
  };

  If SRAM is enabled and clock changing is allowed the driver can be directly
  used by the DT based cpufreq driver (enabled by CONFIG_CPUFREQ_DT). At least

  if CPU references the right clock and sane operating points (OPP) are
  provided. E.g.

  cpu@0 {
      compatible = "mips,mips4KEc";
      reg = <0>;
      clocks = <&ccu CLK_CPU>;
      operating-points-v2 = <&cpu_opp_table>;
  };

  cpu_opp_table: opp-table-0 {
      compatible = "operating-points-v2";
      opp-shared;
      opp00 {
          opp-hz = /bits/ 64 <425000000>;
      };
      ...
  }

  Changing of clocks is often realized by busy waiting. When using that feature
  the additional load should be considered.

properties:
  "#clock-cells":
    const: 1

  compatible:
    enum:
      - realtek,rtl838x-clock
      - realtek,rtl839x-clock
      - realtek,rtl930x-clock

required:
  - "#clock-cells"
  - compatible

examples:
  - |
  ccu: clock-controller {
 	compatible = "realtek,rtl838x-clock";
 	#clock-cells = <1>;
 	clocks = <&osc>;
 	clock-names = "ref_clk";
 	pll_reclock_sram = <&sram0>;
  };

  osc: oscillator {
    compatible = "fixed-clock";
    #clock-cells = <0>;
    clock-frequency = <25000000>;
  };

  sram0: sram@9f000000 {
  ...
 	pll_reclock_sram@0 {
 		reg = <0x0 0x20>;
 		pool;
 	};
  };

...
```

## target/linux/realtek/files-6.12/Documentation/devicetree/bindings/dma/realtek,rtl9300-btg-dma.yaml
```yaml
# SPDX-License-Identifier: (GPL-2.0-only OR BSD-2-Clause)
%YAML 1.2
---
$id: http://devicetree.org/schemas/dma/realtek,rtl9300-btg-dma.yaml#
$schema: http://devicetree.org/meta-schemas/core.yaml#

title: Realtek RTL9300 BTG DMA controller

maintainers:
  - Bevan Weiss <bevan.weiss@gmail.com>

allOf:
  - $ref: dma-controller.yaml#

properties:
  compatible:
    oneOf:
      - enum:
          - realtek,rtl930x-btg-dma
          - realtek,rtl931x-btg-dma

  "#dma-cells":
    const: 1

  interrupts:
    maxItems: 1

  dma-coherent: true

  dma-channels:
    $ref: /schemas/types.yaml#/definitions/uint32
    description:
      Indicates supported number of virtual DMA channels.

  reg:
    maxItems: 1

required:
  - compatible
  - "#dma-cells"
  - interrupts
  - reg

anyOf:
  - required:
      - qcom,powered-remotely
  - required:
      - qcom,controlled-remotely
  - required:
      - clocks
      - clock-names

additionalProperties: false

examples:
  - |
    #include <dt-bindings/interrupt-controller/arm-gic.h>
    #include <dt-bindings/clock/qcom,gcc-msm8974.h>

    lx0_btg@144000 {
        compatible = "qcom,bam-v1.4.0";
        reg = <0x1b144000 0x23C>;
        interrupts = <GIC_SPI 239 IRQ_TYPE_LEVEL_HIGH>;
        dma-channels = <16>;
        #dma-cells = <1>;
        qcom,ee = <0>;
    };
...
```

## target/linux/realtek/files-6.12/drivers/dma/realtek/KConfig
```kconfig
# SPDX-License-Identifier: GPL-2.0-only
#
# Realtek DMA drivers
#

config DMA_RTL9300
	tristate "Realtek RTL9300 BTG/DMA controller"
	depends on MACH_REALTEK_RTL || COMPILE_TEST
	select DMA_ENGINE
	select DMA_VIRTUAL_CHANNELS
	help
	  This selects support for the DMA controller in Realtek RTL9300 SoCs.
	  If you have a board based on such a SoC and wish to use DMA for
	  devices which can use the DMA controller, say Y or M here.
```
